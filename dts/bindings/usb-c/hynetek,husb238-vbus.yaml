## dts/bindings/usb-c/hynetek,husb238-vbus.yaml
```yaml
# Copyright (c) 2025 Ian Wakely
# SPDX-License-Identifier: Apache-2.0

description: Hynetek USB Type-C VBus Controller

compatible: "hynetek,husb238-vbus"

include: [base.yaml]
```
