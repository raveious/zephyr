/*
 * Copyright (c) 2024 Ian Wakely
 */

/delete-node/ &flash0;

#include <espressif/esp32s3/esp32s3_wroom_n4r2.dtsi>
#include "adafruit_qt_py_esp32s3_procpu_common.dtsi"

/ {
	model = "Adafruit QT Py ESP32S3 PSRAM PROCPU";
};
