## boards/shields/adafruit_audio_bff/Kconfig.defconfig
```kconfig
# Copyright (c) 2024 Ian Wakely
# SPDX-License-Identifier: Apache-2.0

if SHIELD_ADAFRUIT_AUDIO_BFF

if DISK_DRIVERS

config DISK_DRIVER_SDMMC
	default y

endif # DISK_DRIVERS

endif # SHIELD_ADAFRUIT_AUDIO_BFF
```

## boards/shields/adafruit_can_bus_bff/Kconfig.shield
```kconfig
# Copyright (c) 2024 Ian Wakely
# SPDX-License-Identifier: Apache-2.0

config SHIELD_ADAFRUIT_CAN_BUS_BFF
	def_bool $(shields_list_contains,adafruit_can_bus_bff)
```

## boards/shields/adafruit_usb_pd_dummy/Kconfig.shield
```kconfig
# Copyright (c) 2025 Ian Wakely
# SPDX-License-Identifier: Apache-2.0

config SHIELD_ADAFRUIT_USB_PD_DUMMY
	def_bool $(shields_list_contains,adafruit_usb_pd_dummy)
```

## drivers/usb_c/tcpc/Kconfig.tcpc_husb238
```kconfig
# Hynetek HUSB238 TCPC configuration options

# Copyright (c) 2025 Ian Wakely
# SPDX-License-Identifier: Apache-2.0

config USBC_TCPC_HUSB238
	bool "USB-C TCPC device controller driver"
	default y
	depends on DT_HAS_HYNETEK_HUSB238_TCPC_ENABLED
	help
	  Enable Type-C Port Controller driver for Hynetek HUSB238.

if USBC_TCPC_HUSB238

config USBC_TCPC_HUSB238_RESET_ON_INIT
	bool "Issue reset command when initializing the device"
	default False

endif
```

## dts/bindings/display/solomon,ssd1351-spi.yaml
```yaml
# Copyright (c) 2023, Ian Wakely
# SPDX-License-Identifier: Apache-2.0

description: SSD1351 128x128 Dot-Matrix OLED/PLED Segment/Common Driver with Controller on SPI bus

compatible: "solomon,ssd1351-spi"

include: ["spi-device.yaml", "display-controller.yaml"]

properties:
  data_cmd-gpios:
    type: phandle-array
    required: false
    description: D/C# pin.
```

## dts/bindings/gpio/adafruit,eyespi.yaml
```yaml
# Copyright (c) 2023 Ian Wakely
# SPDX-License-Identifier: Apache-2.0

description: |
    GPIO pins exposed on Adafruit EYESPI Connector.

    This binding provides a nexus mapping for 16 of the 18 pins in the EYESPI
    connector. Starting with Vin on physical pin 1, the corresponding GPIO
    pins are as depicted below:

        - Vin
        0 LITE
        - GND
        1 SCK
        2 MOSI
        3 MISO
        4 TFT DC
        5 TFT_RST
        6 TFT_CS
        7 CARD_CS
        8 MEM_CS
        9 TS_CS
       10 SCL
       11 SDA
       12 INT
       13 BUSY
       14 GPIO1
       15 GPIO2

compatible: "adafruit,eyespi"

include: [gpio-nexus.yaml, base.yaml]
```

## dts/bindings/tcpc/hynetek,husb238.yaml
```yaml
# Copyright (c) 2025
# SPDX-License-Identifier: Apache-2.0

description: Hynetek USB Type-C Power Delivery Sink Controller

compatible: "hynetek,husb238-tcpc"

include: [base.yaml, pinctrl-device.yaml]

properties:
  reg:
    required: true
```
